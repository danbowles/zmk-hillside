## config/boards/shields/hillside48/Kconfig.defconfig
```kconfig
# Copyright (c) 2021 The ZMK Contributors
# SPDX-License-Identifier: MIT

config ZMK_KEYBOARD_NAME
    default "Hillside48"

if SHIELD_HILLSIDE48_LEFT || SHIELD_HILLSIDE48_RIGHT

config ZMK_SPLIT
    default y

endif
```

## config/west.yml
```yaml
manifest:
  remotes:
    - name: zmkfirmware
      url-base: https://github.com/zmkfirmware
    - name: scybin
      url-base: https://github.com/scybin
  projects:
    - name: zmk
      remote: zmkfirmware
      revision: v0.3
      import: app/west.yml
    - name: zmk-driver-pim447
      remote: scybin
      revision: master
  self:
    path: config
```
